## configs/marble_defconfig
```kconfig
CONFIG_XNU_BUILD_ARCHIVES=y
CONFIG_XNU_SOURCE_CORECRYPTO14=y
CONFIG_XNU_SOURCE_PTHREAD=y
CONFIG_XNU_ARM_DT_PLATFORM=y
CONFIG_XNU_ARMCPU=y
CONFIG_XNU_NATIVE_ARCH_TIMER=y
CONFIG_XNU_NATIVE_PAN=y
CONFIG_XNU_CRYPTO_BOOTSTRAP="prelinked"
CONFIG_XNU_DT_PANIC_REGION=y
CONFIG_XNU_SHENG_PMGR=y
CONFIG_XNU_EXTRA_LD_ARCHIVES="-Wl,-force_load,{tree}/build/native-root-block/libNativeRootBlock.a"
CONFIG_XNU_ROOT_STAGE_CACHE=y
CONFIG_XNU_OWNER_CACHE_MOUNT=y
CONFIG_XNU_OWNER_CACHE_STARTUP=y
CONFIG_XNU_OWNER_UNION_SYSTEMOS=y
CONFIG_XNU_NATIVE_CS_HASH_CACHE=y
```
